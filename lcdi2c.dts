/dts-v1/;
/plugin/;
/ {
    fragment@0 {
        target = <&i2c3>;
        __overlay__ {
            #address-cells = <1>;
            #size-cells = <0>;

            lcdi2c: lcdi2c@27 {
                compatible = "pcf8574,lcdi2c";
                reg = <0x27>;
                status = "okay";
            };
        };
    };
};
